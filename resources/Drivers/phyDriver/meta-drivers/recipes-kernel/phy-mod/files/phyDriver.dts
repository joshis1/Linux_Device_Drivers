/dts-v1/;
/plugin/;

/ {
fragment@0 {
     target = <&amba>;
	__overlay__ {
        #address-cells = <0x1>;
	#size-cells = <0x0>;
	custom_port_phy {
        #address-cells = <1>;
	#size-cells = <0>;
	compatible = "custom,custom-port-phy";
	Dummy_Port_Phy0: dummy_port_phy@0 {
	  			       reg = <0>;
				       speed = <1000>;
				};
				Dummy_Port_Phy1: dummy_port_phy@1 {
					reg = <1>;
					speed = <1000>;
				};
			};
		};
	};
};
