## resources/Drivers/phyDriver/meta-drivers/conf/layer.conf
```bitbake
# We have a conf and classes directory, add to BBPATH
BBPATH .= ":${LAYERDIR}"

# We have recipes-* directories, add to BBFILES
BBFILES += "${LAYERDIR}/recipes-*/*/*.bb \
            ${LAYERDIR}/recipes-*/*/*.bbappend"

BBFILE_COLLECTIONS += "meta-drivers"
BBFILE_PATTERN_meta-drivers = "^${LAYERDIR}/"
BBFILE_PRIORITY_meta-drivers = "6"

LAYERDEPENDS_meta-drivers = "core"
LAYERSERIES_COMPAT_meta-drivers = "warrior"
```

## resources/KernelSource_4_19v/drivers/char/SJDriver/Kconfig
```kconfig
menu "SJ-Custom Modules"
  config CUSTOM_HELLOWORLD
  tristate "hello world module support"
  default m
endmenu
```
